## dts/bindings/arm,pl011.yaml
```yaml
description: ARM PL011 UART

compatible: "arm,pl011"

include: uart-controller.yaml

properties:
    reg:
      required: true

      # MJL: changed to false
    interrupts:
      required: false

    pd-id:
      type: array
      required: false
      description: Power domain index for the component
```

## dts/bindings/arm,scp-clk-dev.yaml
```yaml
# SCP firmware clock device software configuration


description:  Driver and API indexes for SCP clock software module configuration.

compatible: "arm,scp-clk-dev"

include: base.yaml

properties:  
  name:
    type: string
    required: true

  driver-id:
    required: true
    type: array

  api-id:
    required: true
    type: array

  pd-source-id:
    required: false
    type: array


    
```

## dts/bindings/arm/arm,pl011.yaml
```yaml
description: ARM PL011 UART

compatible: "arm,pl011"

include: uart-controller.yaml

properties:
    reg:
      required: true

      # MJL: changed to false
    interrupts:
      required: false

    scp-ids:
      type: phandle-array
      required: false
      description: SCP ID for the power domain of the component.
```

## dts/bindings/juno/arm,juno-ppu.yaml
```yaml
# SCP firmware, juno PPU module configuration

description: Configuration table for Juno PPU modules.

compatible: "arm,juno-ppu"

include: base.yaml

properties:
  reg:
    description: Base address for the PPU device
    required: true
    type: array

  scp-ids:
    description: SCP framework module ID for the timer used in the PPU. Set to none if not present.
    required: false
    type: phandle-array

  pd-type:
    description: SCP Power domain type identifier.
    required: false
    type: int

  irq-nums:
    description: Ordered list of 3 irq numbers for wakeup_irq, wakeup_fiq and warm_reset_irq
    required: false
    type: array

  elem-idx: 
    description: table array index for PPU configuration
    required: true
    type: int
```

## dts/bindings/juno/arm,juno-rom.yaml
```yaml
# SCP firmware, juno ROM module

description: Configuration information for Juno ROM

compatible: "arm,juno-rom"

include: base.yaml

properties:
  ap-context:
     description: Application Processor memory context area, address and size
     required: true
     type: array

  ram-fw-base:
     description: Firmware RAM base address
     required: true
     type: int
```

## dts/bindings/scp/arm,scp-bootloader.yaml
```yaml
description: SCP Bootloader module configuration.

compatible: "arm,scp-bootloader"

include: base.yaml

properties:
  source:
    description: Memory address and size of the image to load at boot.
    required: true
    type: array

  destination:
    description: Memory address and size of the image destination area.
    required: true
    type: array

  sds_id:
    description: SDS region ID in the SDS area if present.
    required: false
    type: int
```

## dts/bindings/scp/arm,scp-clk-dev.yaml
```yaml
# SCP firmware clock device software configuration

description:  Driver and API indexes for SCP clock software module configuration.

compatible: "arm,scp-clk-dev"

include: base.yaml

properties:  
  name:
    type: string
    required: true

  scp-ids:
    description: Array of framework element IDs in order - driver ID, api-id and optional  pd-source-id
    required: true
    type: phandle-array


    
```

## dts/bindings/scp/arm,scp-elem-id.yaml
```yaml
description: SCP software framework module element ID 

compatible: "arm,scp-elem-id"

include: base.yaml

scp-id-cells:
    - mod-idx       # module index
    - elem-idx      # element index
```

## dts/bindings/scp/arm,scp-gtimer.yaml
```yaml
description: SCP Generic Timer configuration

compatible: "arm,scp-gtimer"

include: base.yaml

properties:
  label: 
    required: true

  timer-addr:
    description: Address of the devices timer register
    type: array
    required: true

  counter-addr:
    description: Address of the devices counter register
    type: array
    required: true

  control-addr:
    description: Address of the devices control register
    type: array
    required: true

  frequency: 
    description: Frequency in Hz that the timer ticks at
    required: true
    type: int

  scp-ids: 
    description: SCP framework Element ID for clock that this device depends on
    required: false
    type: phandle-array
```

## dts/bindings/scp/arm,scp-mock-clock.yaml
```yaml
description: SCP Mock Clock

compatible: "arm,scp-mock-clock"

include: base.yaml

properties:
    label:
      required: true

    rate-table:
      description: Table of frequency values
      type: array
      required: true

    default-rate:
      description: Default rate used for clock
      type: int
      required: true
```

## dts/bindings/scp/arm,scp-mock-psu.yaml
```yaml
description: SCP Mock PSU Configuration

compatible: "arm,scp-mock-psu"

include: base.yaml

properties:
  label: 
    required: true

  elem-idx:
    description: SCP PSU software module index for this element
    type: int
    required: true

  scp-ids:
    description: optional SCP Framework ID for Async alarm
    required: false
    type: phandle-array

  default-voltage:
    description: Default voltage for PSU element
    required: true
    type: int

  default-enabled:
    description: Set if PSU element is enabled by default
    required: false
    type: boolean
```

## dts/bindings/scp/arm,scp-mod-id.yaml
```yaml
description: SCP software framework module  ID 

compatible: "arm,scp-mod-id"

include: base.yaml

scp-id-cells:
    - mod-idx       # module index
```

## dts/bindings/scp/arm,scp-pd-mask-table.yaml
```yaml
description: SCP Power Domain mask table

compatible: "arm,scp-pd-mask-table"

include: base.yaml

properties:
  label: 
    description: Name of table object in SCP firmware
    required: true

  pd-states:
    description: Array of PD states associated with the mask values.
    type: array
    required: true

  mask-values:
    description: Mask values for power domain states. 1 value per pd-states entry
    type: array
    required: true
```

## dts/bindings/scp/arm,scp-power-domain.yaml
```yaml
description: SCP Power Domain Configuration

compatible: "arm,scp-power-domain"

include: base.yaml

properties:
  label: 
    required: true

  pd-type:
    description: Power Domain type
    required: true
    type: int

  pd-idx:
    description: SCP PD software module index for this element
    type: int
    required: true

  pd-parent:
    description: reference to parent power domain. Default to none.
    type: phandle
    required: false

  scp-ids:
    description: Array of SCP framework IDs; [0] element or module ID for driver, [1] elem ID for api
    required: true
    type: phandle-array

#  driver-id:
#    description: SCP driver / module ID pair or module single id
#    required: true
#    type: array

#  api-id:
#    description: SCP api / module ID pair
#    required: true
#    type: array
  
  allowed-mask-table: 
    description: reference to a table of allowed masks
    required: true
    type: phandle

  disable-state-trans-notifications:
    description: Flag to disable notifications for state transitions
    required: false
    type: boolean
    
```

## dts/bindings/scp/arm,scp-scmi-agent.yaml
```yaml
description: SCP SCMI agent table configuration

compatible: "arm,scp-scmi-agent"

include: base.yaml

properties:
    label:
        description: Agent Name
        required: true

    agent-type:
        description: SCMI Agent Type
        required: true
        type: int

    agent-idx:
        description: Agent index reference
        required: true
        type: int
```

## dts/bindings/scp/arm,scp-scmi-service.yaml
```yaml
description: SCP SCMI agent service table

compatible: "arm,scp-scmi-service"

include: base.yaml

properties:
    label:
        description: service name
        required: true

    service-idx:
        description: index into service table of this scmi service
        required: true
        type: int

    scp-ids:
        description: Ordered array of scp-ids; transport ID, transport API ID, notification ID
        required: true
        type: phandle-array

    scmi-agent-id:
        description: Index for agent using channel
        required: true
        type: int

    scmi-p2a-id:
        description: SCP element ID for P2A if used, as array of module idx, service index
        required: false
        type: array
```

## dts/bindings/scp/arm,scp-scmi.yaml
```yaml
description: SCP SCMI base configuration

compatible: "arm,scp-scmi"

include: base.yaml

properties:
    protocol-count-max:
        description: Maximum protocols for this SCMI server
        required: true
        type: int

    vendor-identifier:
        required: true
        type: string

    sub-vendor-identifier:
        required: true
        type: string

    psci-dis-protocols:
        description: PCSI disallowed protocols
        required: false
        type: array
        
```

## dts/bindings/scp/arm,scp-sds-region.yaml
```yaml
description: SCP SDS region descriptions

compatible: "arm,scp-sds-region"

include: base.yaml

properties:
  region-idx: 
    required: true
    type: int
    description: SCP region index for this element

  reg:
    required: true
    description: Base address and size for this region
  
```

## dts/bindings/scp/arm,scp-sds.yaml
```yaml
description: SCP SDS element descriptor table. Series of data elements in the SDS area

compatible: "arm,scp-sds"

include: base.yaml

properties:
  label: 
    required: true

  table-idx:
    description: descriptor array table index for this SDS data element
    required: true
    type: int

  data-id-size:
    description: Array containing data id and size for this SDS data element.
    required: true
    type: array
    
  region-id:
    description: SDS memory region identifier this SDS data table resides in..
    required: true
    type: int

  finalize:
    description: Flag to finalise SDS element.
    required: false
    type: boolean
```

## dts/bindings/scp/arm,scp-sys-power-dev.yaml
```yaml
description: SCP System power device driver

compatible: "arm,scp-sys-power-dev"

include: base.yaml

properties:
  label: 
    description: Name of device object in SCP firmware
    required: true

  scp-ids:
    description: SCP frameworks IDs for ordered for system ppu driver and api
    required: true
    type: phandle-array

  sys-state-table:
    description: reference to a power state table used by the device
    type: phandle
    required: true

  
```

## dts/bindings/scp/arm,scp-sys-power-table.yaml
```yaml
description: SCP System power state table

compatible: "arm,scp-sys-power-table"

include: base.yaml

properties:
  label: 
    description: Name of table object in SCP firmware
    required: true

  power-states:
    description: Array of power states associated with the state values.
    type: array
    required: true

  power-values:
    description: Values for system power states. 1 value per power-states entry
    type: array
    required: true
```

## dts/bindings/scp/arm,scp-system-power.yaml
```yaml
description: SCP System power initial configuration

compatible: "arm,scp-system-power"

include: base.yaml

properties:
  soc-wakeup-irq:
    type: int
    required: true

  scp-ids:
     description: Ordered SCP framework IDs,  module ID for driver, element ID for API
     required: true
     type: phandle-array

  init-pwr-state:
    description: Initial system power state.
    type: int
    required: true
  
  
```

## dts/bindings/scp/arm,scp-timer.yaml
```yaml
description: SCP timer configuration

compatible: "arm,scp-timer"

include: base.yaml

properties:
    label: 
      required: true

    scp-ids:
      description: SCP Framework module or element ID for the driver
      required: true
      type: phandle-array

    timer-irq:
      description: Timer IRQ for the device
      required: true
      type: int

    sub-elem-count:
      description: Number of sub elements associated with the timer.
      required: false
      type: int
```
