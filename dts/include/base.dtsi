/*
 * Arm SCP/MCP Software
 * Copyright (c) 2021, Arm Limited and Contributors. All rights reserved.
 *
 * SPDX-License-Identifier: BSD-3-Clause
 */

/* base level common device tree include */

/* include the framework common bindings */
#include "fwk_dt_bindings.h"


/dts-v1/;
/ {
	#address-cells = <1>;
	#size-cells = <1>;
	chosen { };
	aliases { };
};
