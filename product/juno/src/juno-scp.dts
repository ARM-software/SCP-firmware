/*
 * Arm SCP/MCP Software
 * Copyright (c) 2021, Arm Limited and Contributors. All rights reserved.
 *
 * SPDX-License-Identifier: BSD-3-Clause
 */

#include "juno-scp-base.dtsi"

/ {
	model = "Juno Development Platform (r0-r2)";
	compatible = "arm,juno";


};